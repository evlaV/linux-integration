## drivers/hid/lenovo-lego-hid/Kconfig
```kconfig
config LENOVO_LEGO_HID
	tristate "Lenovo Legion Go HID"
	depends on USB_HID
	depends on LEDS_CLASS
	depends on LEDS_CLASS_MULTICOLOR
	help
	  Say Y here to include support for the Lenovo Legion Go Handheld
	  Console Controller.

	  To compile this driver as a module, choose M here: the module will
	  be called lenovo-lego-hid.
```
