## drivers/input/joystick/gip/Kconfig
```kconfig
# SPDX-License-Identifier: GPL-2.0-or-later
#
# Gaming Input Protocol  driver configuration
#
config JOYSTICK_XBOX_GIP
	tristate "Xbox One/Series controller support"
	depends on USB && USB_ARCH_HAS_HCD && LEDS_CLASS_MULTICOLOR && CRYPTO_ECDH
	help
	  Say Y here if you want to use Xbox One and Series controllers with your
	  computer. Make sure to say Y to "Joystick support" (CONFIG_INPUT_JOYDEV)
	  and/or "Event interface support" (CONFIG_INPUT_EVDEV) as well.

	  To compile this driver as a module, choose M here: the
	  module will be called xbox_gip.

config JOYSTICK_XBOX_GIP_FF
	bool "Xbox One/Series controller rumble support"
	depends on JOYSTICK_XBOX_GIP && INPUT
	select INPUT_FF_MEMLESS
	help
	  Say Y here if you want to take advantage of Xbox One/Series rumble.
```
